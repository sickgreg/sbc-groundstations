## package/otg-forwarder/Config.in
```kconfig
config BR2_PACKAGE_OTG_FORWARDER
	bool "otg-forwarder"
	help
	  Headless OTG video/control forwarder for Radxa Zero 3W images.
```

## package/otg-webui/Config.in
```kconfig
config BR2_PACKAGE_OTG_WEBUI
	bool "otg-webui"
	depends on BR2_PACKAGE_PYTHON3
	depends on BR2_PACKAGE_OTG_FORWARDER
	help
	  Small USB-gadget web control panel for special headless OTG mode.
```
